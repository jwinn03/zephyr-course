## app/Kconfig
```kconfig
menuconfig LED_SUBSYSTEM
    bool "LED Subsystem"
    default y

if LED_SUBSYSTEM

config BLINK_SLEEP_TIME_MS
    int
    default 250 if BLINK_SLEEP_250MS
    default 1000 if BLINK_SLEEP_1000MS
    default 2000 if BLINK_SLEEP_2000MS
    default 0

choice
    prompt "LED blink sleep time"
    default BLINK_SLEEP_1000MS

config BLINK_SLEEP_250MS
    bool "Fast (250ms)"

config BLINK_SLEEP_1000MS
    bool "Medium (1s)"

config BLINK_SLEEP_2000MS
    bool "Slow (2s)"
endchoice

    menuconfig ADVANCED_LED_SETTINGS
        bool "Advanced LED settings"
        default n

    if ADVANCED_LED_SETTINGS

    config LED_BRIGHTNESS
        int "LED brightness (0-100)"
        range 0 100
        default 100

    config LED_FADE_DURATION_MS
        int "LED fade duration (ms)"
        default 500

    menu "Expert settings"
    
        config ENABLE_LED_DEBUGGING
            bool "Enable LED debugging"
        
        config CUSTOM_BLINK_PATTERN
            bool "Custom blink pattern"

    endmenu

    endif # ADVANCED_LED_SETTINGS

endif # LED_SUBSYSTEM


source "Kconfig.zephyr"
```

## app/boards/my_board/board.yml
```yaml
board:
  name: my_board
  full_name: My Board
  vendor: Me Industries
  socs:
  - name: esp32s3
```

## app/boards/our_board/board.yml
```yaml
board:
  name: our_board
  full_name: Our Board
  vendor: Me Industries
  socs:
  - name: esp32s3
```

## app/dts/bindings/driver/our,driver.yaml
```yaml
description: Our custom LED driver binding
compatible: "our,driver"
include: sensor-device.yaml

properties:
  led-gpios:
    type: phandle-array
    required: true
```

## twister-out.4/native_sim_native/host/homework.unit.ring_buf/Kconfig/arch/Kconfig
```kconfig
# Load Zephyr Arch Kconfig descriptions.
osource "/home/shohem/Documents/dev/deps/zephyr/arch/rx/Kconfig"
osource "/home/shohem/Documents/dev/deps/zephyr/arch/x86/Kconfig"
osource "/home/shohem/Documents/dev/deps/zephyr/arch/xtensa/Kconfig"
osource "/home/shohem/Documents/dev/deps/zephyr/arch/sparc/Kconfig"
osource "/home/shohem/Documents/dev/deps/zephyr/arch/riscv/Kconfig"
osource "/home/shohem/Documents/dev/deps/zephyr/arch/posix/Kconfig"
osource "/home/shohem/Documents/dev/deps/zephyr/arch/mips/Kconfig"
osource "/home/shohem/Documents/dev/deps/zephyr/arch/arm64/Kconfig"
osource "/home/shohem/Documents/dev/deps/zephyr/arch/arm/Kconfig"
osource "/home/shohem/Documents/dev/deps/zephyr/arch/arc/Kconfig"
```

## twister-out/native_sim_native/host/homework.unit.ring_buf/Kconfig/Kconfig.modules
```kconfig
menu "cmsis_6 (/home/shohem/Documents/dev/deps/modules/hal/cmsis_6)"
osource "$(ZEPHYR_CMSIS_6_KCONFIG)"
config ZEPHYR_CMSIS_6_MODULE
	bool
	default y
endmenu
menu "hal_espressif (/home/shohem/Documents/dev/deps/modules/hal/espressif)"
osource "/home/shohem/Documents/dev/deps/modules/hal/espressif/zephyr/Kconfig"
config ZEPHYR_HAL_ESPRESSIF_MODULE
	bool
	default y

config ZEPHYR_HAL_ESPRESSIF_MODULE_BLOBS
	bool
endmenu
```

## twister-out/native_sim_native/host/homework.unit.ring_buf/Kconfig/boards/Kconfig.native_sim
```kconfig
# Load board Kconfig descriptions.
osource "/home/shohem/Documents/dev/deps/zephyr/boards/native/native_sim/Kconfig.native_sim"
```
